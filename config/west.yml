## config/west.yml
```yaml
manifest:
  remotes:
    - name: djak250
      url-base: https://github.com/djak250
  projects:
    - name: zmk
      remote: djak250
      revision: v20250120-rgb
      import: app/west.yml
  self:
    path: config
```
